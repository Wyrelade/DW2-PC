SECTIONS
{
    HIDDEN(__romPos = 0);
    _gp = 0x800506F8;
    stag3500_ROM_START = __romPos;
    stag3500_VRAM = ADDR(.stag3500);
    .stag3500 0x80063360 : AT(stag3500_ROM_START) SUBALIGN(4)
    {
        FILL(0x00000000);
        stag3500_RODATA_START = .;
        build/USA/asm/USA/stag3500/data/stag3500_rodata.rodata.s.o(.rodata);
        build/USA/src/stag3500/bg.c.o(.rodata);
        build/USA/src/stag3500/fightbg.c.o(.rodata);
        build/USA/src/stag3500/actionload.c.o(.rodata);
        build/USA/src/stag3500/stag3500.c.o(.rodata);
        build/USA/src/stag3500/vsmenu.c.o(.rodata);
        build/USA/src/stag3500/matchup.c.o(.rodata);
        build/USA/src/stag3500/battle.c.o(.rodata);
        build/USA/src/stag3500/textrect.c.o(.rodata);
        build/USA/src/stag3500/turn.c.o(.rodata);
        build/USA/src/stag3500/parts.c.o(.rodata);
        build/USA/src/stag3500/fighter.c.o(.rodata);
        build/USA/src/stag3500/roundbanner.c.o(.rodata);
        build/USA/src/stag3500/xaplay.c.o(.rodata);
        build/USA/src/stag3500/hud.c.o(.rodata);
        build/USA/src/stag3500/battlescript.c.o(.rodata);
        build/USA/src/stag3500/camera.c.o(.rodata);
        build/USA/src/stag3500/cmdlist.c.o(.rodata);
        build/USA/src/stag3500/winbanner.c.o(.rodata);
        . = ALIGN(., 4);
        stag3500_RODATA_END = .;
        stag3500_RODATA_SIZE = ABSOLUTE(stag3500_RODATA_END - stag3500_RODATA_START);
        stag3500_TEXT_START = .;
        build/USA/src/stag3500/bg.c.o(.text);
        build/USA/src/stag3500/fightbg.c.o(.text);
        build/USA/src/stag3500/actionload.c.o(.text);
        build/USA/src/stag3500/stag3500.c.o(.text);
        build/USA/src/stag3500/vsmenu.c.o(.text);
        build/USA/src/stag3500/matchup.c.o(.text);
        build/USA/src/stag3500/battle.c.o(.text);
        build/USA/src/stag3500/textrect.c.o(.text);
        build/USA/src/stag3500/turn.c.o(.text);
        build/USA/src/stag3500/parts.c.o(.text);
        build/USA/src/stag3500/fighter.c.o(.text);
        build/USA/src/stag3500/roundbanner.c.o(.text);
        build/USA/src/stag3500/xaplay.c.o(.text);
        build/USA/src/stag3500/hud.c.o(.text);
        build/USA/src/stag3500/battlescript.c.o(.text);
        build/USA/src/stag3500/camera.c.o(.text);
        build/USA/src/stag3500/cmdlist.c.o(.text);
        build/USA/src/stag3500/winbanner.c.o(.text);
        . = ALIGN(., 4);
        stag3500_TEXT_END = .;
        stag3500_TEXT_SIZE = ABSOLUTE(stag3500_TEXT_END - stag3500_TEXT_START);
        stag3500_DATA_START = .;
        build/USA/asm/USA/stag3500/data/stag3500_rodata.rodata.s.o(.data);
        build/USA/src/stag3500/bg.c.o(.data);
        build/USA/src/stag3500/fightbg.c.o(.data);
        build/USA/src/stag3500/actionload.c.o(.data);
        build/USA/src/stag3500/stag3500.c.o(.data);
        build/USA/src/stag3500/vsmenu.c.o(.data);
        build/USA/src/stag3500/matchup.c.o(.data);
        build/USA/src/stag3500/battle.c.o(.data);
        build/USA/src/stag3500/textrect.c.o(.data);
        build/USA/src/stag3500/turn.c.o(.data);
        build/USA/src/stag3500/parts.c.o(.data);
        build/USA/src/stag3500/fighter.c.o(.data);
        build/USA/src/stag3500/roundbanner.c.o(.data);
        build/USA/src/stag3500/xaplay.c.o(.data);
        build/USA/src/stag3500/hud.c.o(.data);
        build/USA/src/stag3500/battlescript.c.o(.data);
        build/USA/src/stag3500/camera.c.o(.data);
        build/USA/src/stag3500/cmdlist.c.o(.data);
        build/USA/src/stag3500/winbanner.c.o(.data);
        . = ALIGN(., 4);
        stag3500_DATA_END = .;
        stag3500_DATA_SIZE = ABSOLUTE(stag3500_DATA_END - stag3500_DATA_START);
        stag3500_BSS_START = .;
        build/USA/asm/USA/stag3500/data/stag3500_rodata.rodata.s.o(.bss);
        build/USA/src/stag3500/bg.c.o(.bss);
        build/USA/src/stag3500/fightbg.c.o(.bss);
        build/USA/src/stag3500/actionload.c.o(.bss);
        build/USA/src/stag3500/stag3500.c.o(.bss);
        build/USA/src/stag3500/vsmenu.c.o(.bss);
        build/USA/src/stag3500/matchup.c.o(.bss);
        build/USA/src/stag3500/battle.c.o(.bss);
        build/USA/src/stag3500/textrect.c.o(.bss);
        build/USA/src/stag3500/turn.c.o(.bss);
        build/USA/src/stag3500/parts.c.o(.bss);
        build/USA/src/stag3500/fighter.c.o(.bss);
        build/USA/src/stag3500/roundbanner.c.o(.bss);
        build/USA/src/stag3500/xaplay.c.o(.bss);
        build/USA/src/stag3500/hud.c.o(.bss);
        build/USA/src/stag3500/battlescript.c.o(.bss);
        build/USA/src/stag3500/camera.c.o(.bss);
        build/USA/src/stag3500/cmdlist.c.o(.bss);
        build/USA/src/stag3500/winbanner.c.o(.bss);
        . = ALIGN(., 4);
        stag3500_BSS_END = .;
        stag3500_BSS_SIZE = ABSOLUTE(stag3500_BSS_END - stag3500_BSS_START);
    }
    __romPos += SIZEOF(.stag3500);
    __romPos = ALIGN(__romPos, 4);
    . = ALIGN(., 4);
    stag3500_ROM_END = __romPos;
    stag3500_VRAM_END = .;

    /DISCARD/ :
    {
        *(*);
    }
}
