SECTIONS
{
    HIDDEN(__romPos = 0);
    _gp = 0x800506F8;
    header_ROM_START = __romPos;
    header_VRAM = ADDR(.header);
    .header : AT(header_ROM_START) SUBALIGN(4)
    {
        FILL(0x00000000);
        header_DATA_START = .;
        build/USA/asm/USA/main/header.s.o(.data);
        header_DATA_END = .;
        header_DATA_SIZE = ABSOLUTE(header_DATA_END - header_DATA_START);
    }
    __romPos += SIZEOF(.header);
    header_ROM_END = __romPos;
    header_VRAM_END = .;

    main_ROM_START = __romPos;
    main_VRAM = ADDR(.main);
    .main 0x80010000 : AT(main_ROM_START) SUBALIGN(4)
    {
        FILL(0x00000000);
        main_RODATA_START = .;
        build/USA/asm/USA/main/data/800.rodata.s.o(.rodata);
        build/USA/src/main/156C.c.o(.rodata);
        build/USA/src/main/task.c.o(.rodata);
        build/USA/src/main/cdpreload.c.o(.rodata);
        build/USA/src/main/portrait.c.o(.rodata);
        build/USA/src/main/faceslot.c.o(.rodata);
        build/USA/src/main/itemeffect.c.o(.rodata);
        build/USA/src/main/nameentry.c.o(.rodata);
        build/USA/src/main/gamemode.c.o(.rodata);
        build/USA/src/main/topmenu.c.o(.rodata);
        build/USA/src/main/submenu.c.o(.rodata);
        build/USA/src/main/status.c.o(.rodata);
        build/USA/src/main/itemuse.c.o(.rodata);
        build/USA/src/main/itemmenu.c.o(.rodata);
        build/USA/src/main/digilist.c.o(.rodata);
        build/USA/src/main/digistatus.c.o(.rodata);
        build/USA/src/main/skilllist.c.o(.rodata);
        build/USA/src/main/spawnlist.c.o(.rodata);
        build/USA/src/main/winframe.c.o(.rodata);
        build/USA/src/main/sound.c.o(.rodata);
        build/USA/src/main/text.c.o(.rodata);
        build/USA/src/main/gpu.c.o(.rodata);
        build/USA/src/main/fade.c.o(.rodata);
        build/USA/src/main/ot.c.o(.rodata);
        build/USA/src/main/primbuf.c.o(.rodata);
        build/USA/src/main/texslot.c.o(.rodata);
        build/USA/src/main/parts.c.o(.rodata);
        build/USA/src/main/digibase.c.o(.rodata);
        build/USA/src/main/gamedata.c.o(.rodata);
        build/USA/src/main/flagtable.c.o(.rodata);
        build/USA/src/main/digidata.c.o(.rodata);
        build/USA/src/main/shadow.c.o(.rodata);
        build/USA/src/main/skill.c.o(.rodata);
        build/USA/src/main/anim.c.o(.rodata);
        build/USA/src/main/model.c.o(.rodata);
        build/USA/src/main/12550.c.o(.rodata);
        build/USA/src/main/flags.c.o(.rodata);
        build/USA/src/main/savedata.c.o(.rodata);
        build/USA/src/main/mem.c.o(.rodata);
        build/USA/src/main/pad.c.o(.rodata);
        build/USA/src/main/sys.c.o(.rodata);
        build/USA/src/main/cd.c.o(.rodata);
        build/USA/src/main/cdread.c.o(.rodata);
        build/USA/src/main/fxmodel.c.o(.rodata);
        build/USA/src/main/psyq.c.o(.rodata);
        . = ALIGN(., 4);
        main_RODATA_END = .;
        main_RODATA_SIZE = ABSOLUTE(main_RODATA_END - main_RODATA_START);
        main_TEXT_START = .;
        build/USA/src/main/156C.c.o(.text);
        build/USA/src/main/task.c.o(.text);
        build/USA/src/main/cdpreload.c.o(.text);
        build/USA/src/main/portrait.c.o(.text);
        build/USA/src/main/faceslot.c.o(.text);
        build/USA/src/main/itemeffect.c.o(.text);
        build/USA/src/main/nameentry.c.o(.text);
        build/USA/src/main/gamemode.c.o(.text);
        build/USA/src/main/topmenu.c.o(.text);
        build/USA/src/main/submenu.c.o(.text);
        build/USA/src/main/status.c.o(.text);
        build/USA/src/main/itemuse.c.o(.text);
        build/USA/src/main/itemmenu.c.o(.text);
        build/USA/src/main/digilist.c.o(.text);
        build/USA/src/main/digistatus.c.o(.text);
        build/USA/src/main/skilllist.c.o(.text);
        build/USA/src/main/spawnlist.c.o(.text);
        build/USA/src/main/winframe.c.o(.text);
        build/USA/src/main/sound.c.o(.text);
        build/USA/src/main/text.c.o(.text);
        build/USA/src/main/gpu.c.o(.text);
        build/USA/src/main/fade.c.o(.text);
        build/USA/src/main/ot.c.o(.text);
        build/USA/src/main/primbuf.c.o(.text);
        build/USA/src/main/texslot.c.o(.text);
        build/USA/src/main/parts.c.o(.text);
        build/USA/src/main/digibase.c.o(.text);
        build/USA/src/main/gamedata.c.o(.text);
        build/USA/src/main/flagtable.c.o(.text);
        build/USA/src/main/digidata.c.o(.text);
        build/USA/src/main/shadow.c.o(.text);
        build/USA/src/main/skill.c.o(.text);
        build/USA/src/main/anim.c.o(.text);
        build/USA/src/main/model.c.o(.text);
        build/USA/src/main/12550.c.o(.text);
        build/USA/src/main/flags.c.o(.text);
        build/USA/src/main/savedata.c.o(.text);
        build/USA/src/main/mem.c.o(.text);
        build/USA/src/main/pad.c.o(.text);
        build/USA/src/main/sys.c.o(.text);
        build/USA/src/main/cd.c.o(.text);
        build/USA/src/main/cdread.c.o(.text);
        build/USA/src/main/fxmodel.c.o(.text);
        build/USA/src/main/psyq.c.o(.text);
        . = ALIGN(., 4);
        main_TEXT_END = .;
        main_TEXT_SIZE = ABSOLUTE(main_TEXT_END - main_TEXT_START);
        main_DATA_START = .;
        build/USA/asm/USA/main/data/800.rodata.s.o(.data);
        build/USA/src/main/156C.c.o(.data);
        build/USA/src/main/task.c.o(.data);
        build/USA/src/main/cdpreload.c.o(.data);
        build/USA/src/main/portrait.c.o(.data);
        build/USA/src/main/faceslot.c.o(.data);
        build/USA/src/main/itemeffect.c.o(.data);
        build/USA/src/main/nameentry.c.o(.data);
        build/USA/src/main/gamemode.c.o(.data);
        build/USA/src/main/topmenu.c.o(.data);
        build/USA/src/main/submenu.c.o(.data);
        build/USA/src/main/status.c.o(.data);
        build/USA/src/main/itemuse.c.o(.data);
        build/USA/src/main/itemmenu.c.o(.data);
        build/USA/src/main/digilist.c.o(.data);
        build/USA/src/main/digistatus.c.o(.data);
        build/USA/src/main/skilllist.c.o(.data);
        build/USA/src/main/spawnlist.c.o(.data);
        build/USA/src/main/winframe.c.o(.data);
        build/USA/src/main/sound.c.o(.data);
        build/USA/src/main/text.c.o(.data);
        build/USA/src/main/gpu.c.o(.data);
        build/USA/src/main/fade.c.o(.data);
        build/USA/src/main/ot.c.o(.data);
        build/USA/src/main/primbuf.c.o(.data);
        build/USA/src/main/texslot.c.o(.data);
        build/USA/src/main/parts.c.o(.data);
        build/USA/src/main/digibase.c.o(.data);
        build/USA/src/main/gamedata.c.o(.data);
        build/USA/src/main/flagtable.c.o(.data);
        build/USA/src/main/digidata.c.o(.data);
        build/USA/src/main/shadow.c.o(.data);
        build/USA/src/main/skill.c.o(.data);
        build/USA/src/main/anim.c.o(.data);
        build/USA/src/main/model.c.o(.data);
        build/USA/src/main/12550.c.o(.data);
        build/USA/src/main/flags.c.o(.data);
        build/USA/src/main/savedata.c.o(.data);
        build/USA/src/main/mem.c.o(.data);
        build/USA/src/main/pad.c.o(.data);
        build/USA/src/main/sys.c.o(.data);
        build/USA/src/main/cd.c.o(.data);
        build/USA/asm/USA/main/data/38110.data.s.o(.data);
        build/USA/src/main/cdread.c.o(.data);
        build/USA/src/main/fxmodel.c.o(.data);
        build/USA/src/main/psyq.c.o(.data);
        build/USA/asm/USA/main/data/395F0.data.s.o(.data);
        . = ALIGN(., 4);
        main_DATA_END = .;
        main_DATA_SIZE = ABSOLUTE(main_DATA_END - main_DATA_START);
        main_SDATA_START = .;
        build/USA/src/main/task.c.o(.sdata);
        build/USA/src/main/gamemode.c.o(.sdata);
        build/USA/src/main/itemuse.c.o(.sdata);
        build/USA/src/main/itemmenu.c.o(.sdata);
        build/USA/src/main/digilist.c.o(.sdata);
        build/USA/src/main/skilllist.c.o(.sdata);
        build/USA/src/main/sound.c.o(.sdata);
        build/USA/src/main/12550.c.o(.sdata);
        build/USA/src/main/savedata.c.o(.sdata);
        build/USA/src/main/mem.c.o(.sdata);
        build/USA/src/main/sys.c.o(.sdata);
        build/USA/src/main/cd.c.o(.sdata);
        . = ALIGN(., 4);
        main_SDATA_END = .;
        main_SDATA_SIZE = ABSOLUTE(main_SDATA_END - main_SDATA_START);
        main_SBSS_START = .;
        build/USA/src/main/task.c.o(.sbss);
        build/USA/src/main/cdpreload.c.o(.sbss);
        build/USA/src/main/itemeffect.c.o(.sbss);
        build/USA/src/main/topmenu.c.o(.sbss);
        build/USA/src/main/itemuse.c.o(.sbss);
        build/USA/src/main/sound.c.o(.sbss);
        build/USA/src/main/skill.c.o(.sbss);
        build/USA/src/main/mem.c.o(.sbss);
        build/USA/src/main/sys.c.o(.sbss);
        build/USA/src/main/cd.c.o(.sbss);
        . = ALIGN(., 4);
        main_SBSS_END = .;
        main_SBSS_SIZE = ABSOLUTE(main_SBSS_END - main_SBSS_START);
        main_BSS_START = .;
        build/USA/asm/USA/main/data/800.rodata.s.o(.bss);
        build/USA/src/main/156C.c.o(.bss);
        build/USA/src/main/task.c.o(.bss);
        build/USA/src/main/cdpreload.c.o(.bss);
        build/USA/src/main/portrait.c.o(.bss);
        build/USA/src/main/faceslot.c.o(.bss);
        build/USA/src/main/itemeffect.c.o(.bss);
        build/USA/src/main/nameentry.c.o(.bss);
        build/USA/src/main/gamemode.c.o(.bss);
        build/USA/src/main/topmenu.c.o(.bss);
        build/USA/src/main/submenu.c.o(.bss);
        build/USA/src/main/status.c.o(.bss);
        build/USA/src/main/itemuse.c.o(.bss);
        build/USA/src/main/itemmenu.c.o(.bss);
        build/USA/src/main/digilist.c.o(.bss);
        build/USA/src/main/digistatus.c.o(.bss);
        build/USA/src/main/skilllist.c.o(.bss);
        build/USA/src/main/spawnlist.c.o(.bss);
        build/USA/src/main/winframe.c.o(.bss);
        build/USA/src/main/sound.c.o(.bss);
        build/USA/src/main/text.c.o(.bss);
        build/USA/src/main/gpu.c.o(.bss);
        build/USA/src/main/fade.c.o(.bss);
        build/USA/src/main/ot.c.o(.bss);
        build/USA/src/main/primbuf.c.o(.bss);
        build/USA/src/main/texslot.c.o(.bss);
        build/USA/src/main/parts.c.o(.bss);
        build/USA/src/main/digibase.c.o(.bss);
        build/USA/src/main/gamedata.c.o(.bss);
        build/USA/src/main/flagtable.c.o(.bss);
        build/USA/src/main/digidata.c.o(.bss);
        build/USA/src/main/shadow.c.o(.bss);
        build/USA/src/main/skill.c.o(.bss);
        build/USA/src/main/anim.c.o(.bss);
        build/USA/src/main/model.c.o(.bss);
        build/USA/src/main/12550.c.o(.bss);
        build/USA/src/main/flags.c.o(.bss);
        build/USA/src/main/savedata.c.o(.bss);
        build/USA/src/main/mem.c.o(.bss);
        build/USA/src/main/pad.c.o(.bss);
        build/USA/src/main/sys.c.o(.bss);
        build/USA/src/main/cd.c.o(.bss);
        build/USA/src/main/cdread.c.o(.bss);
        build/USA/src/main/fxmodel.c.o(.bss);
        build/USA/src/main/psyq.c.o(.bss);
        build/USA/asm/USA/main/data/505D8.data.s.o(.data);
        build/USA/assets/Ovl_LoadArea.bin.o(.data);
        . = ALIGN(., 4);
        main_BSS_END = .;
        main_BSS_SIZE = ABSOLUTE(main_BSS_END - main_BSS_START);
    }
    __romPos += SIZEOF(.main);
    __romPos = ALIGN(__romPos, 4);
    . = ALIGN(., 4);
    main_ROM_END = __romPos;
    main_VRAM_END = .;

    /DISCARD/ :
    {
        *(*);
    }
}
