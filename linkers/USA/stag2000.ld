SECTIONS
{
    HIDDEN(__romPos = 0);
    _gp = 0x800506F8;
    stag2000_ROM_START = __romPos;
    stag2000_VRAM = ADDR(.stag2000);
    .stag2000 0x80063360 : AT(stag2000_ROM_START) SUBALIGN(4)
    {
        FILL(0x00000000);
        stag2000_RODATA_START = .;
        build/USA/asm/USA/stag2000/data/stag2000_rodata.rodata.s.o(.rodata);
        build/USA/src/stag2000/mapbg.c.o(.rodata);
        build/USA/src/stag2000/staticbg.c.o(.rodata);
        build/USA/src/stag2000/digilab.c.o(.rodata);
        build/USA/src/stag2000/itemshop.c.o(.rodata);
        build/USA/src/stag2000/beetleshop.c.o(.rodata);
        build/USA/src/stag2000/stag2000.c.o(.rodata);
        build/USA/src/stag2000/areaselect.c.o(.rodata);
        build/USA/src/stag2000/labmodesel.c.o(.rodata);
        build/USA/src/stag2000/labroster.c.o(.rodata);
        build/USA/src/stag2000/msgwin.c.o(.rodata);
        build/USA/src/stag2000/labcaption.c.o(.rodata);
        build/USA/src/stag2000/labinfo.c.o(.rodata);
        build/USA/src/stag2000/labskills.c.o(.rodata);
        build/USA/src/stag2000/labpair.c.o(.rodata);
        build/USA/src/stag2000/dna.c.o(.rodata);
        build/USA/src/stag2000/shadow.c.o(.rodata);
        build/USA/src/stag2000/labjogbg.c.o(.rodata);
        build/USA/src/stag2000/labdigimodel.c.o(.rodata);
        build/USA/src/stag2000/mapexit.c.o(.rodata);
        build/USA/src/stag2000/walker.c.o(.rodata);
        build/USA/src/stag2000/xastream.c.o(.rodata);
        build/USA/src/stag2000/shopbg.c.o(.rodata);
        build/USA/src/stag2000/shopbits.c.o(.rodata);
        build/USA/src/stag2000/itemshopmenu.c.o(.rodata);
        build/USA/src/stag2000/beetleshopmenu.c.o(.rodata);
        build/USA/src/stag2000/stag2000_8CE0.c.o(.rodata);
        . = ALIGN(., 4);
        stag2000_RODATA_END = .;
        stag2000_RODATA_SIZE = ABSOLUTE(stag2000_RODATA_END - stag2000_RODATA_START);
        stag2000_TEXT_START = .;
        build/USA/src/stag2000/mapbg.c.o(.text);
        build/USA/src/stag2000/staticbg.c.o(.text);
        build/USA/src/stag2000/digilab.c.o(.text);
        build/USA/src/stag2000/itemshop.c.o(.text);
        build/USA/src/stag2000/beetleshop.c.o(.text);
        build/USA/src/stag2000/stag2000.c.o(.text);
        build/USA/src/stag2000/areaselect.c.o(.text);
        build/USA/src/stag2000/labmodesel.c.o(.text);
        build/USA/src/stag2000/labroster.c.o(.text);
        build/USA/src/stag2000/msgwin.c.o(.text);
        build/USA/src/stag2000/labcaption.c.o(.text);
        build/USA/src/stag2000/labinfo.c.o(.text);
        build/USA/src/stag2000/labskills.c.o(.text);
        build/USA/src/stag2000/labpair.c.o(.text);
        build/USA/src/stag2000/dna.c.o(.text);
        build/USA/src/stag2000/shadow.c.o(.text);
        build/USA/src/stag2000/labjogbg.c.o(.text);
        build/USA/src/stag2000/labdigimodel.c.o(.text);
        build/USA/src/stag2000/mapexit.c.o(.text);
        build/USA/src/stag2000/walker.c.o(.text);
        build/USA/src/stag2000/xastream.c.o(.text);
        build/USA/src/stag2000/shopbg.c.o(.text);
        build/USA/src/stag2000/shopbits.c.o(.text);
        build/USA/src/stag2000/itemshopmenu.c.o(.text);
        build/USA/src/stag2000/beetleshopmenu.c.o(.text);
        build/USA/src/stag2000/stag2000_8CE0.c.o(.text);
        . = ALIGN(., 4);
        stag2000_TEXT_END = .;
        stag2000_TEXT_SIZE = ABSOLUTE(stag2000_TEXT_END - stag2000_TEXT_START);
        stag2000_DATA_START = .;
        build/USA/asm/USA/stag2000/data/stag2000_rodata.rodata.s.o(.data);
        build/USA/src/stag2000/mapbg.c.o(.data);
        build/USA/src/stag2000/staticbg.c.o(.data);
        build/USA/src/stag2000/digilab.c.o(.data);
        build/USA/src/stag2000/itemshop.c.o(.data);
        build/USA/src/stag2000/beetleshop.c.o(.data);
        build/USA/src/stag2000/stag2000.c.o(.data);
        build/USA/src/stag2000/areaselect.c.o(.data);
        build/USA/src/stag2000/labmodesel.c.o(.data);
        build/USA/src/stag2000/labroster.c.o(.data);
        build/USA/src/stag2000/msgwin.c.o(.data);
        build/USA/src/stag2000/labcaption.c.o(.data);
        build/USA/src/stag2000/labinfo.c.o(.data);
        build/USA/src/stag2000/labskills.c.o(.data);
        build/USA/src/stag2000/labpair.c.o(.data);
        build/USA/src/stag2000/dna.c.o(.data);
        build/USA/src/stag2000/shadow.c.o(.data);
        build/USA/src/stag2000/labjogbg.c.o(.data);
        build/USA/src/stag2000/labdigimodel.c.o(.data);
        build/USA/src/stag2000/mapexit.c.o(.data);
        build/USA/src/stag2000/walker.c.o(.data);
        build/USA/src/stag2000/xastream.c.o(.data);
        build/USA/src/stag2000/shopbg.c.o(.data);
        build/USA/src/stag2000/shopbits.c.o(.data);
        build/USA/src/stag2000/itemshopmenu.c.o(.data);
        build/USA/src/stag2000/beetleshopmenu.c.o(.data);
        build/USA/src/stag2000/stag2000_8CE0.c.o(.data);
        . = ALIGN(., 4);
        stag2000_DATA_END = .;
        stag2000_DATA_SIZE = ABSOLUTE(stag2000_DATA_END - stag2000_DATA_START);
        stag2000_BSS_START = .;
        build/USA/asm/USA/stag2000/data/stag2000_rodata.rodata.s.o(.bss);
        build/USA/src/stag2000/mapbg.c.o(.bss);
        build/USA/src/stag2000/staticbg.c.o(.bss);
        build/USA/src/stag2000/digilab.c.o(.bss);
        build/USA/src/stag2000/itemshop.c.o(.bss);
        build/USA/src/stag2000/beetleshop.c.o(.bss);
        build/USA/src/stag2000/stag2000.c.o(.bss);
        build/USA/src/stag2000/areaselect.c.o(.bss);
        build/USA/src/stag2000/labmodesel.c.o(.bss);
        build/USA/src/stag2000/labroster.c.o(.bss);
        build/USA/src/stag2000/msgwin.c.o(.bss);
        build/USA/src/stag2000/labcaption.c.o(.bss);
        build/USA/src/stag2000/labinfo.c.o(.bss);
        build/USA/src/stag2000/labskills.c.o(.bss);
        build/USA/src/stag2000/labpair.c.o(.bss);
        build/USA/src/stag2000/dna.c.o(.bss);
        build/USA/src/stag2000/shadow.c.o(.bss);
        build/USA/src/stag2000/labjogbg.c.o(.bss);
        build/USA/src/stag2000/labdigimodel.c.o(.bss);
        build/USA/src/stag2000/mapexit.c.o(.bss);
        build/USA/src/stag2000/walker.c.o(.bss);
        build/USA/src/stag2000/xastream.c.o(.bss);
        build/USA/src/stag2000/shopbg.c.o(.bss);
        build/USA/src/stag2000/shopbits.c.o(.bss);
        build/USA/src/stag2000/itemshopmenu.c.o(.bss);
        build/USA/src/stag2000/beetleshopmenu.c.o(.bss);
        build/USA/src/stag2000/stag2000_8CE0.c.o(.bss);
        . = ALIGN(., 4);
        stag2000_BSS_END = .;
        stag2000_BSS_SIZE = ABSOLUTE(stag2000_BSS_END - stag2000_BSS_START);
    }
    __romPos += SIZEOF(.stag2000);
    __romPos = ALIGN(__romPos, 4);
    . = ALIGN(., 4);
    stag2000_ROM_END = __romPos;
    stag2000_VRAM_END = .;

    /DISCARD/ :
    {
        *(*);
    }
}
